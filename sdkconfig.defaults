## sdkconfig.defaults
```kconfig
# SenseCAP Watcher - ESP32-S3 SDK Config Defaults

# Target chip
CONFIG_IDF_TARGET="esp32s3"

# CPU
CONFIG_ESP32S3_DEFAULT_CPU_FREQ_240=y

# PSRAM - 8MB Octal SPI
CONFIG_SPIRAM=y
CONFIG_SPIRAM_MODE_OCT=y
CONFIG_SPIRAM_SPEED_80M=y
CONFIG_SPIRAM_BOOT_INIT=y

# Flash - 32MB QIO
CONFIG_ESPTOOLPY_FLASHSIZE_32MB=y
CONFIG_ESPTOOLPY_FLASHFREQ_80M=y
CONFIG_ESPTOOLPY_FLASHMODE_QIO=y

# Partition table
CONFIG_PARTITION_TABLE_CUSTOM=y
CONFIG_PARTITION_TABLE_CUSTOM_FILENAME="partitions.csv"

# WiFi
CONFIG_ESP_WIFI_ENABLED=y

# Bluetooth
CONFIG_BT_ENABLED=y
CONFIG_BT_NIMBLE_ENABLED=y

# Console via UART (CH344 USB-UART bridge on ttyACM2)
CONFIG_ESP_CONSOLE_UART_DEFAULT=y

# LVGL
CONFIG_LV_COLOR_16_SWAP=y
CONFIG_LV_FONT_MONTSERRAT_14=y
CONFIG_LV_FONT_MONTSERRAT_20=y
CONFIG_LV_MEMCPY_MEMSET_STD=y

# TLS — disable hardware RSA to avoid interrupt exhaustion
# (WiFi + I2S + SPI LCD + I2C touch + I2C audio + LEDC + RMT use all slots)
CONFIG_MBEDTLS_HARDWARE_MPI=n

# Logging
CONFIG_LOG_DEFAULT_LEVEL_INFO=y
CONFIG_LOG_MAXIMUM_LEVEL_DEBUG=y
```
